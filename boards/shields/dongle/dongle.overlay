/ {
    chosen {
        zmk,keyboard = &kbd;
    };

    kbd: keyboard {
        compatible = "zmk,keyboard";

        matrix_transform = <&default_transform>;
    };

    default_transform: matrix_transform {
        compatible = "zmk,matrix-transform";
        rows = <1>;
        columns = <1>;
        map = <0>;
    };
};
