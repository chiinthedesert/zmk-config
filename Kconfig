## Kconfig
```kconfig
config BOOT_BATTERY_LED
    bool "Enable boot battery LED blink"
    default y
    depends on ZMK_BATTERY
```

## config/west.yml
```yaml
manifest:
  defaults:
    revision: v0.3
  remotes:
    - name: zmkfirmware
      url-base: https://github.com/zmkfirmware
    - name: bluedrink9
      url-base: https://github.com/bluedrink9
  projects:
    - name: zmk
      remote: zmkfirmware
      import: app/west.yml
    - name: zmk-poor-mans-led-indicator
      remote: bluedrink9
      revision: main
  self:
    path: config
```

## custom/Kconfig
```kconfig
config BOOT_BATTERY_LED
    bool "Enable boot battery LED blink"
    default n
    depends on ZMK_BATTERY

config BOOT_OLED
    bool "Turn off OLED 5 seconds after boot"
    depends on ZMK_DISPLAY
    default n
```
