/ {
    aliases {
        indicator-led = &led0;
    };

    /* If led0 isn't defined by your board, define it here: */
    leds {
        compatible = "gpio-leds";
        led0: led_0 {
            gpios = <&gpio0 15 GPIO_ACTIVE_HIGH>;
        };
    };
};
